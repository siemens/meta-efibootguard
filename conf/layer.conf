## conf/layer.conf
```bitbake
# EFI Boot Guard
#
# Copyright (c) Siemens AG, 2017
#
# Authors:
#   Andreas Reichel <andreas.reichel.ext@siemens.com>
#
# This work is licensed under the terms of the GNU GPL, version 2.
# See the COPYING.GPLv2 file in the top-level directory.

BBPATH .= ":${LAYERDIR}"

BBFILES += "${LAYERDIR}/recipes-*/*/*.bb \
	${LAYERDIR}/recipes-*/*/*.bbappend"

BBFILE_COLLECTIONS += "efibootguard"
BBFILE_PATTERN_efibootguard = "^${LAYERDIR}/"
BBFILE_PRIORITY_efibootguard = "6"

LAYERSERIES_COMPAT_efibootguard = "rocko sumo thud warrior zeus dunfell"
```
